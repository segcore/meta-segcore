## conf/distro/small-distro.conf
```bitbake
DISTRO = "small-distro"
DISTRO_NAME = "Small Distro (Segcore)"
DISTRO_VERSION = "1.0.0"
DISTRO_CODENAME = "SmallCore"
SDK_VENDOR = "-scsdk"
SDK_VERSION = "${@d.getVar('DISTRO_VERSION').replace('snapshot-${METADATA_REVISION}', 'snapshot')}"
SDK_VERSION[vardepvalue] = "${SDK_VERSION}"

MAINTAINER = "Segcore @ github"

TARGET_VENDOR = "-segcore"

LOCALCONF_VERSION = "2"

DISTRO_FEATURES ?= "ext2 ipv4 ipv6 xattr vfat seccomp ipv4"

VIRTUAL-RUNTIME_dev_manager = ""
DISTRO_FEATURES_BACKFILL_CONSIDERED = "systemd pulseaudio sysvinit gobject-introspection-data ldconfig"

PREFERRED_VERSION_linux-yocto ?= "6.6%"
PREFERRED_VERSION_linux-yocto-rt ?= "6.6%"

SDK_NAME = "${DISTRO}-${TCLIBC}-${SDKMACHINE}-${IMAGE_BASENAME}-${TUNE_PKGARCH}-${MACHINE}"
SDKPATHINSTALL = "/opt/${DISTRO}/${SDK_VERSION}"

DISTRO_EXTRA_RDEPENDS += "packagegroup-core-boot"
DISTRO_EXTRA_RRECOMMENDS += "kernel-module-af-packet"

TCLIBCAPPEND = ""

PACKAGE_CLASSES ?= "package_rpm"

require conf/distro/include/poky-world-exclude.inc
require conf/distro/include/no-static-libs.inc
require conf/distro/include/yocto-uninative.inc
require conf/distro/include/security_flags.inc
INHERIT += "uninative"

BB_SIGNATURE_HANDLER ?= "OEEquivHash"
BB_HASHSERVE ??= "auto"

INIT_MANAGER ?= "sysvinit"

# We need debug symbols so that SPDX license manifests for the kernel work
# KERNEL_EXTRA_FEATURES:append = " features/debug/debug-kernel.scc"

# Enable creation of SPDX manifests by default
# INHERIT += "create-spdx"
```

## conf/layer.conf
```bitbake
# We have a conf and classes directory, add to BBPATH
BBPATH .= ":${LAYERDIR}"

# We have recipes-* directories, add to BBFILES
BBFILES += "${LAYERDIR}/recipes-*/*/*.bb \
            ${LAYERDIR}/recipes-*/*/*.bbappend"

BBFILE_COLLECTIONS += "meta-segcore"
BBFILE_PATTERN_meta-segcore = "^${LAYERDIR}/"
BBFILE_PRIORITY_meta-segcore = "6"

LAYERDEPENDS_meta-segcore = "core"
LAYERSERIES_COMPAT_meta-segcore = "scarthgap"
```

## conf/machine/small-machine.conf
```bitbake
# This file is not necessarily complete.

# x86-64 tuning
DEFAULTTUNE ?= "core2-64"
require conf/machine/include/x86/tune-core2.inc

KBRANCH:small-machine  = "standard/base"
KMACHINE:small-machine ?= "common-pc-64"
COMPATIBLE_MACHINE:small-machine = "small-machine"

# COMPATIBLE_MACHINE:genericx86-64 = "genericx86-64"
# KBRANCH:genericx86-64  = "v6.6/standard/base"
# KMACHINE:genericx86-64 ?= "common-pc-64"

###### conf/machine/include/x86/x86-base.inc
#
# Base machine settings for X86 architecture BSPs
MACHINE_FEATURES += " keyboard ext2 ext3 x86 serial efi "

IMAGE_FSTYPES ?= "ext4 wic"
WKS_FILE ?= "genericx86.wks.in"

KERNEL_IMAGETYPE ?= "bzImage"
SERIAL_CONSOLES ?= "115200;ttyS0"
######################### meta-yocto-bsp/conf/machine/include/genericx86-common.inc
PREFERRED_VERSION_linux-yocto ?= "6.6%"
PREFERRED_PROVIDER_virtual/kernel ?= "linux-yocto"

MACHINE_EXTRA_RRECOMMENDS += "kernel-modules linux-firmware"

# EFI_PROVIDER ??= "grub-efi"
# EFI_PROVIDER ??= "systemd-boot"
EFI_PROVIDER ?= "${@bb.utils.contains("DISTRO_FEATURES", "systemd", "systemd-boot", "grub-efi", d)}"

do_image_wic[depends] += "gptfdisk-native:do_populate_sysroot"
do_image_wic[recrdeptask] += "do_bootimg"

# MACHINE_ESSENTIAL_EXTRA_RDEPENDS += "v86d"
# MACHINE_EXTRA_RRECOMMENDS = "kernel-module-snd-ens1370 kernel-module-snd-rawmidi"

# WKS_FILE ?= "qemux86-directdisk.wks"
# do_image_wic[depends] += "syslinux:do_populate_sysroot syslinux-native:do_populate_sysroot mtools-native:do_populate_sysroot dosfstools-native:do_populate_sysroot"

#For runqemu
# QB_SYSTEM_NAME = "qemu-system-x86_64"

####################### qemu arm

# Install all the kernel modules into the rootfs
# MACHINE_EXTRA_RRECOMMENDS += "kernel-modules"
# Install selected pieces of firmware

# Use an initramfs and populate it with the kernel modules and key firmware
# INITRAMFS_IMAGE ?= "core-image-initramfs-boot"
# PACKAGE_INSTALL:append:pn-core-image-initramfs-boot = " ${MACHINE_EXTRA_RRECOMMENDS}"

# Try to bring up one physical serial console, or a virtualized serial console
SERIAL_CONSOLES ?= "115200;ttyAMA0 115200;hvc0"
```
